ORG 0000H			//JUMPING TO THE MAIN LOOP
	LJMP MAIN
	
ORG 000BH			//JUMPING TO THE USER DEFINED TIMER 0 INTERRUPT SUBROUTINE
	LJMP TIMER0_INTERRUPT


MAIN:
MOV A,#00H			
MOV P1,A				//INITIALIZING PORT1 TO ZERO
MOV TMOD,#00000001B		//SETTING TIMER MODE TO MODE1(16 BIT TIMER)
DELAY:      //LOOP FOR ITERATING TIMER 2^16 TIMES
CLR TR0					//STOPPING THE TIMER
MOV R2,#6D				//LOADING VALUE TO REGISTER
LOOP:
MOV TH0,#0000H			//INTIALIZING TH 
MOV TL0,#0000H			//INITIALIZING TL
SETB TR0				//STARTING THE TIMER
HERE: 
JNB TF0, HERE			//LOOP UNTIL TIMER DOES NOT OVERFLOW
CLR TF0					//CLEARING TIMER OVERFLOW FLAG
CLR TR0					//STOPPING THE TIMER
DJNZ R2,LOOP			
MOV IE,#82H				//INITIALIZING INTERRUPT ENABLE
MOV TH0,#0E8H           
MOV TL0,#0B9H
SETB TR0				//STARTING THE TIMER0
HERE2: 
JNB TF0, HERE2	//LOOP UNTIL TIMER DOES NOT OVERFLOW

//SJMP DELAY


TIMER0_INTERRUPT:
 SETB P1.0				//SETTING UNSED PIN
 CPL P1.1				//COMPLEMENTING OUTPUT OF LED
 CLR P1.0				//CLEARING UNSED PIN
 
 SJMP DELAY
 RETI				
 
 END